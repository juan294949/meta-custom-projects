## conf/layer.conf
```bitbake
BBPATH .= ":${LAYERDIR}"

BBFILES += "${LAYERDIR}/recipes-*/*/*.bb \
            ${LAYERDIR}/recipes-*/*/*.bbappend"

BBFILE_COLLECTIONS += "custom-projects"
LAYERSERIES_COMPAT_custom-projects = "scarthgap"
BBFILE_PATTERN_custom-projects = "^${LAYERDIR}/"
BBFILE_PRIORITY_custom-projects = "6"
```

## meta-stm32f4xx/conf/layer.conf
```bitbake
BBPATH .= ":${LAYERDIR}"

BBFILES += "${LAYERDIR}/recipes-*/*/*.bb \
            ${LAYERDIR}/recipes-*/*/*.bbappend"

BBFILE_COLLECTIONS += "custom-projects"
BBFILE_PATTERN_zybo = "^${LAYERDIR}/"
BBFILE_PRIORITY_zybo = "6"
```
